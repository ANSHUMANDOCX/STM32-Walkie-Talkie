#include "nokia5110.h"
#include "walkie_talkie.h"
#include <string.h>
#include <stdio.h>

/* ─── GPIO helpers ───────────────────────────────────── */
#define LCD_CS_LOW()   HAL_GPIO_WritePin(GPIOB, GPIO_PIN_4, GPIO_PIN_RESET)
#define LCD_CS_HIGH()  HAL_GPIO_WritePin(GPIOB, GPIO_PIN_4, GPIO_PIN_SET)
#define LCD_DC_LOW()   HAL_GPIO_WritePin(GPIOB, GPIO_PIN_5, GPIO_PIN_RESET)  // command
#define LCD_DC_HIGH()  HAL_GPIO_WritePin(GPIOB, GPIO_PIN_5, GPIO_PIN_SET)    // data
#define LCD_RST_LOW()  HAL_GPIO_WritePin(GPIOB, GPIO_PIN_6, GPIO_PIN_RESET)
#define LCD_RST_HIGH() HAL_GPIO_WritePin(GPIOB, GPIO_PIN_6, GPIO_PIN_SET)

/* ─── Frame buffer ───────────────────────────────────── */
static uint8_t fb[LCD_ROWS][LCD_WIDTH];

/* ─── 5x7 ASCII font (printable chars 0x20–0x7F) ────── */
static const uint8_t font[][5] = {
    {0x00,0x00,0x00,0x00,0x00}, // space
    {0x00,0x00,0x5F,0x00,0x00}, // !
    {0x00,0x07,0x00,0x07,0x00}, // "
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    {0x44,0x64,0x54,0x4C,0x44}, // z
};

/* ─── Send byte ──────────────────────────────────────── */
static void LCD_Send(uint8_t byte, bool isData) {
    if (isData) LCD_DC_HIGH(); else LCD_DC_LOW();
    LCD_CS_LOW();
    HAL_SPI_Transmit(&hspi2, &byte, 1, HAL_MAX_DELAY);
    LCD_CS_HIGH();
}

/* ─── Init ───────────────────────────────────────────── */
void LCD_Init(void) {
    LCD_RST_LOW();
    HAL_Delay(10);
    LCD_RST_HIGH();
    HAL_Delay(10);

    LCD_Send(LCD_CMD_FUNC_SET_EXT,    false);
    LCD_Send(LCD_CMD_SET_VOP | 0x3F, false);  // contrast
    LCD_Send(LCD_CMD_SET_TEMP,        false);
    LCD_Send(LCD_CMD_SET_BIAS,        false);
    LCD_Send(LCD_CMD_FUNC_SET_BASIC,  false);
    LCD_Send(LCD_CMD_DISPLAY_NORMAL,  false);

    LCD_Clear();
    LCD_Update();
}

/* ─── Clear frame buffer ─────────────────────────────── */
void LCD_Clear(void) {
    memset(fb, 0, sizeof(fb));
}

/* ─── Push frame buffer to display ──────────────────── */
void LCD_Update(void) {
    for (uint8_t row = 0; row < LCD_ROWS; row++) {
        LCD_Send(LCD_CMD_SET_Y | row,  false);
        LCD_Send(LCD_CMD_SET_X | 0,    false);
        for (uint8_t col = 0; col < LCD_WIDTH; col++) {
            LCD_Send(fb[row][col], true);
        }
    }
}

/* ─── Set cursor ─────────────────────────────────────── */
void LCD_SetCursor(uint8_t x, uint8_t row) {
    LCD_Send(LCD_CMD_SET_Y | (row & 0x07), false);
    LCD_Send(LCD_CMD_SET_X | (x  & 0x7F), false);
}

/* ─── Draw single char into frame buffer ─────────────── */
void LCD_DrawChar(char c) {
    // not used directly — use LCD_DrawString
}

/* ─── Draw string into frame buffer ─────────────────── */
void LCD_DrawString(uint8_t x, uint8_t row, const char *str) {
    while (*str && x < LCD_WIDTH) {
        uint8_t idx = (uint8_t)*str - 0x20;
        if (idx < sizeof(font)/sizeof(font[0])) {
            for (uint8_t col = 0; col < 5 && x < LCD_WIDTH; col++, x++) {
                fb[row][x] = font[idx][col];
            }
            if (x < LCD_WIDTH) fb[row][x++] = 0x00; // char gap
        }
        str++;
    }
}

/* ─── Draw integer ───────────────────────────────────── */
void LCD_DrawInt(uint8_t x, uint8_t row, int32_t val) {
    char buf[12];
    snprintf(buf, sizeof(buf), "%ld", val);
    LCD_DrawString(x, row, buf);
}

/* ─── Screen layout ──────────────────────────────────── */
void LCD_ShowStatus(const char *status) {
    // Clear row 0 first
    memset(fb[0], 0, LCD_WIDTH);
    LCD_DrawString(0, 0, status);
}

void LCD_ShowRSSI(int16_t rssi) {
    char buf[16];
    memset(fb[1], 0, LCD_WIDTH);
    snprintf(buf, sizeof(buf), "RSSI:%ddBm", rssi);
    LCD_DrawString(0, 1, buf);
}

void LCD_ShowBattery(uint8_t pct) {
    char buf[12];
    memset(fb[2], 0, LCD_WIDTH);
    snprintf(buf, sizeof(buf), "BAT: %d%%", pct);
    LCD_DrawString(0, 2, buf);
}

void LCD_ShowCharging(bool charging) {
    memset(fb[3], 0, LCD_WIDTH);
    LCD_DrawString(0, 3, charging ? "CHARGING..." : "           ");
}

void LCD_ShowChannel(uint8_t ch) {
    char buf[10];
    memset(fb[4], 0, LCD_WIDTH);
    snprintf(buf, sizeof(buf), "CH: %d", ch);
    LCD_DrawString(0, 4, buf);
}
